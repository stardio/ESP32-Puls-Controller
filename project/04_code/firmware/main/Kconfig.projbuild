## project/04_code/firmware/main/Kconfig.projbuild
```kconfig
menu "Pulse servo controller (ESP32-P4, 1/2 axis)"

    config FW_AXIS_COUNT
        int "Number of axes (1 = X only, 2 = X and Y)"
        range 1 2
        default 2
        help
          1-axis model: the Y axis (MCPWM group 1, PCNT unit 2, STOP/START/DI of the Y side, DO2) is not created.
          Register area 0x2000 answers exception 02.

    config FW_MODEL_RTU
        bool "Model has RS-485 hardware (U17 ISO1500 mounted): RTU slave can be selected"
        default n
        help
          Off (TCP model): writing comm_mode = RTU (0x400E) is refused (exception 03) and a stored RTU value falls back to TCP.

    config FW_VERSION_MAJOR
        int "Firmware version major"
        default 0
    config FW_VERSION_MINOR
        int "Firmware version minor"
        default 1
    config FW_VERSION_PATCH
        int "Firmware version patch"
        default 0

    config FW_X_PLS_GPIO
        int "X axis pulse GPIO (ISO7720 U1 -> AM26C31 1A)"
        default 25
    config FW_X_DIR_GPIO
        int "X axis direction GPIO"
        default 32
    config FW_Y_PLS_GPIO
        int "Y axis pulse GPIO (ISO7720 U16 -> AM26C31 3A)"
        default 20
    config FW_Y_DIR_GPIO
        int "Y axis direction GPIO"
        default 21
    config FW_OE_GPIO
        int "Shared pulse output enable GPIO (TLP2361 -> AM26C31 /G), LOW at boot"
        default 33
    config FW_OE_ACTIVE_LOW
        bool "Output enable is active LOW (off: HIGH = allowed, baseline v0.4 F-03)"
        default n

    config FW_X_START_GPIO
        int "X START input (DI1), edge; -1 = no START input on this unit"
        default 54
        help
          With the default pull towards the inactive level an unconnected START pin reads "not pressed": no edge, no start.
    config FW_X_STOP_GPIO
        int "X STOP input (DI2), NC contact"
        default 19
    config FW_X_DI3_GPIO
        int "X spare input DI3 (register only)"
        default 18
    config FW_X_DI4_GPIO
        int "X spare input DI4 (register only)"
        default 17
    config FW_Y_START_GPIO
        int "Y START input (DI5), edge; -1 = no START input on this unit"
        default 7
    config FW_Y_STOP_GPIO
        int "Y STOP input (DI6), NC contact"
        default 8
    config FW_Y_DI7_GPIO
        int "Y spare input DI7 (register only)"
        default 15
    config FW_Y_DI8_GPIO
        int "Y spare input DI8 (register only)"
        default 16
    config FW_STOP_ACTIVE_LOW
        bool "STOP input active LOW. Off (default) = NC contact, contact open -> HIGH = STOP (baseline v0.4 F-07)"
        default n
    config FW_START_ACTIVE_LOW
        bool "START and spare inputs active LOW (contact closed -> TLP293 on -> GPIO LOW) [recommended, unverified on the board]"
        default y
    config FW_START_DEBOUNCE_MS
        int "START stable time before an edge is accepted (ms) [recommended 5]"
        range 1 100
        default 5

    config FW_DO1_GPIO
        int "DO1 servo ON X"
        default 23
    config FW_DO2_GPIO
        int "DO2 servo ON Y"
        default 26
    config FW_DO3_GPIO
        int "DO3 general output"
        default 27
    config FW_DO4_GPIO
        int "DO4 general output"
        default 46

    config FW_RS485_TX_GPIO
        int "RS-485 TX"
        default 24
    config FW_RS485_RX_GPIO
        int "RS-485 RX"
        default 47
    config FW_RS485_DE_GPIO
        int "RS-485 DE (UART RTS in half-duplex mode)"
        default 48
    config FW_RTU_UART_NUM
        int "UART number for the RTU slave"
        range 1 4
        default 1
    config FW_PHY_RESET_GPIO
        int "IP101 PHY reset GPIO"
        default 51
    config FW_TCP_PORT
        int "Modbus TCP port"
        default 502

    config FW_IRQ_PRIO_STOP
        int "Interrupt level of the STOP GPIO ISR (0 = default; highest of the ISRs, review M-03)"
        range 0 3
        default 3
    config FW_IRQ_PRIO_PCNT
        int "Interrupt level of the PCNT watch-point ISR (0 = driver default)"
        range 0 3
        default 2
    config FW_UPDATE_MS
        int "Motion task period (profile update, completion check) in ms [recommended 2]"
        range 1 10
        default 2
    config FW_WDT_TIMEOUT_MS
        int "Task watchdog timeout of the motion task (ms) [recommended 1000, T-15 to confirm]"
        range 100 10000
        default 1000
    config FW_PERIOD_IMMEDIATE
        bool "Apply the MCPWM period immediately instead of at the timer-empty event (servo1axis behaviour)"
        default n
        help
          Only to be turned on if HIL check M-05 (first cycle after a start) shows that the TEZ update does not apply the
          start period.
endmenu
```

## project/04_code/test-fw/main/Kconfig.projbuild
```kconfig
menu "TFW test firmware (D-025, G3 pre-test only)"

    config TFW_AX1_PLS_GPIO
        int "Axis 1 pulse GPIO (also PCNT loop-back input)"
        default 25
    config TFW_AX1_DIR_GPIO
        int "Axis 1 direction GPIO"
        default 32
    config TFW_PULSE_OE_GPIO
        int "Pulse output enable GPIO, shared by both axes (baseline v0.4 F-03..F-05: GPIO33 -> TLP2361 -> AM26C31 /G)"
        default 33
        help
          Driven LOW at boot (output forbidden) and raised once after the pulse axes are created.
          It is NOT touched by STOP: STOP only forces the pulse output of its own axis LOW.
    config TFW_PULSE_OE_ACTIVE_LOW
        bool "Pulse output enable is active LOW (off = HIGH allows output, baseline v0.4 F-03)"
        default n
    config TFW_AX2_PLS_GPIO
        int "Axis 2 pulse GPIO (baseline v0.4 F-01: 20; -1 = axis 2 not created)"
        default 20
    config TFW_AX2_DIR_GPIO
        int "Axis 2 direction GPIO (baseline v0.4 F-02: 21; -1 = axis 2 not created)"
        default 21
    config TFW_AXIS_COUNT
        int "Number of axes to bring up (1 or 2)"
        range 1 2
        default 2
    config TFW_ESTOP_GPIO
        int "Axis 1 STOP input GPIO (DI2, J15; baseline v0.4 F-06: GPIO19)"
        default 19
        help
          T-07 stimulus (baseline v0.4 F-12): feed the J15 DI2 terminal from a 24 V switch wired as an NC contact
          (closed in normal operation); opening it is the STOP. Check the boot log: with the switch closed the input
          must read "inactive". If it reads ACTIVE, the TLP293 polarity is the other way round: flip TFW_ESTOP_ACTIVE_LOW.
          Axis 2: the same with the DI4 terminal (GPIO17).
    config TFW_AX2_IO_PRESENT
        bool "Carrier axis 2 DI parts present (DI3 START, DI4 STOP wired) [D-068]"
        default n
        help
          Off (default): axis 2 STOP (GPIO17) and START (GPIO18) are ignored (not configured, never block); axis 2 pulses
          are driven only by Modbus/host commands. This keeps a floating NC-type input from holding axis 2 "always
          stopped" when only the 1-axis carrier is available and GPIO20/21 are measured at the board header.
          Turn on only when the 2-axis carrier (U16, J14, DI3/DI4) is wired.
    config TFW_ESTOP2_GPIO
        int "Axis 2 STOP input GPIO (DI4; baseline v0.4 F-06: GPIO17; -1 = none)"
        default 8
    config TFW_ESTOP_ACTIVE_LOW
        bool "STOP input active LOW. Off (default, baseline v0.4 F-07) = NC contact, active HIGH"
        default n
    config TFW_START_GPIO
        int "Axis 1 START input GPIO (DI1, edge; baseline v0.4 sec.7: GPIO54; -1 = none)"
        default 54
    config TFW_START2_GPIO
        int "Axis 2 START input GPIO (DI3, edge; baseline v0.4 sec.7: GPIO18; -1 = none)"
        default 7
    config TFW_START_ACTIVE_LOW
        bool "START input active LOW (contact closed -> TLP293 on -> GPIO LOW) [recommended default, unverified on the board]"
        default y
    config TFW_START_DEBOUNCE_MS
        int "START input stable time before an edge is accepted [recommended 5 ms]"
        range 1 100
        default 5
    config TFW_DEBUG_GPIO
        int "Debug GPIO toggled in the watch-point ISR (-1 = off)"
        default -1
    config TFW_DEBUG_GPIO_ESTOP
        int "Debug GPIO toggled in the e-stop ISR (-1 = off)"
        default -1
    config TFW_PROBE_GPIO
        int "GPIO used only by the boot-time resource probe (-1 = probe skipped; must not be used by anything else)"
        default -1
    config TFW_IRQ_PRIO_ESTOP
        int "Interrupt level of the e-stop GPIO ISR (0 = default; highest of the three, M-03)"
        range 0 3
        default 3
    config TFW_IRQ_PRIO_PCNT
        int "Interrupt level of the PCNT watch-point ISR (0 = driver default)"
        range 0 3
        default 2
    config TFW_IRQ_PRIO_GPT
        int "Interrupt level of the GPTimer update ISR (0 = driver default)"
        range 0 3
        default 1
    config TFW_UPD_MODE_HWTIMER
        bool "Speed update from GPTimer ISR (off = 10 ms task, reproduces servo1axis)"
        default y
    config TFW_LEGACY_NVS_ON_WRITE
        bool "Save legacy HR values to NVS on every Modbus write (reproduces servo1axis risk 3; T-06 comparison only)"
        default n
    config TFW_IP_A
        int "IP A"
        default 192
    config TFW_IP_B
        int "IP B"
        default 168
    config TFW_IP_C
        int "IP C"
        default 0
    config TFW_IP_D
        int "IP D"
        default 220
    config TFW_PORT
        int "Modbus TCP port"
        default 502
    config TFW_UNIT_ID
        int "Modbus unit id"
        default 1
    config TFW_MAX_CLIENTS
        int "Max simultaneous Modbus TCP clients [assumed 4]"
        default 4
        help
          T-05 uses 4 load clients + the control connection (+ the HMI): build with 8 for T-05,
          keep 4 for the "5th connection is refused" check.
    config TFW_ETM_EXPERIMENT
        bool "Compile the PCNT->MCPWM ETM experiment (not implemented, reports 'not tested')"
        default n
endmenu
```
